## conf/layer.conf
```bitbake
# We have a conf and classes directory, add to BBPATH
BBPATH .= ":${LAYERDIR}"

# We have recipes-* directories, add to BBFILES
BBFILES += "${LAYERDIR}/recipes-*/*/*.bb \
            ${LAYERDIR}/recipes-*/*/*.bbappend"

BBFILE_COLLECTIONS += "meta-somlabs"
BBFILE_PATTERN_meta-somlabs = "^${LAYERDIR}/"
BBFILE_PRIORITY_meta-somlabs = "9"

EULA_FILE_ST:stm32mpvisionsommx = "${LAYERDIR}/conf/eula/${MACHINE}"
EULA_FILE_ST_MD5SUM:stm32mpvisionsommx = "8b505090fb679839cefbcc784afe8ce9"

#Inform bitbake for adding another location to search for licenses
LICENSE_PATH += "${LAYERDIR}/files/licenses"

# Set a variable to get the STM32MP MX BSP location
STM32MP_SOMLABS_BASE = "${LAYERDIR}"

# This should only be incremented on significant changes that may
# cause compatibility issues with other layers
LAYERVERSION_meta-somlabs = "1"
LAYERDEPENDS_meta-somlabs = "stm-st-stm32mp-mx"
LAYERSERIES_COMPAT_meta-somlabs = "kirkstone"
```

## conf/machine/mp157a-dsi-ph-emmc-mx.conf
```bitbake
#@TYPE: Machine
#@NAME: mp157a-dsi-ph-emmc-mx
#@DESCRIPTION: Configuration for VisionSOM-STM32MP157A eMMC module with VisionCB-STD-STM32MP1 board with ph720128t003 dsi display 
#@NEEDED_BSPLAYERS: layers/meta-openembedded/meta-oe layers/meta-openembedded/meta-python layers/meta-st/meta-st-stm32mp-addons

include conf/machine/include/mp157a-common.inc

DEVICE_STORAGE = "EMMC:mmc0, NAND:nand0, NOR:nor0, SDCARD:mmc1, SPINAND:spi-nand0"

# Connected display orientation: 'portrait', 'landscape'
DISPLAY_ORIENTATION = "portrait"

# Define the boot device supported
BOOTDEVICE_LABELS += "emmc"

# Assign CubeMX Board devicetree and project path name
CUBEMX_DTB = "stm32mp157a-dsi-ph720128t003-emmc-mx"
CUBEMX_PROJECT = "mx/stm32mp157a-dsi-ph720128t003-emmc-mx"
```

## conf/machine/mp157a-hdmi-lt-sd-mx.conf
```bitbake
#@TYPE: Machine
#@NAME: mp157a-hdmi-lt-sd-mx
#@DESCRIPTION: Configuration for VisionSOM-STM32MP157A SD-card module with VisionCB-STD-STM32MP1 board with lt8912b HDMI bridge 
#@NEEDED_BSPLAYERS: layers/meta-openembedded/meta-oe layers/meta-openembedded/meta-python layers/meta-st/meta-st-stm32mp-addons

include conf/machine/include/mp157a-common.inc

DEVICE_STORAGE = "SDCARD:mmc0, NAND:nand0, NOR:nor0, EMMC:mmc1, SPINAND:spi-nand0"

# Connected display orientation: 'portrait', 'landscape'
DISPLAY_ORIENTATION = "landscape"

# Define the boot device supported
BOOTDEVICE_LABELS += "sdcard"

# Assign CubeMX Board devicetree and project path name
CUBEMX_DTB = "stm32mp157a-hdmi-lt8912b-sd-mx"
CUBEMX_PROJECT = "mx/stm32mp157a-hdmi-lt8912b-sd-mx"
```

## conf/machine/mp157a-rgb-ph-emmc-mx.conf
```bitbake
#@TYPE: Machine
#@NAME: mp157a-rgb-ph-emmc-mx
#@DESCRIPTION: Configuration for VisionSOM-STM32MP157A eMMC module with VisionCB-STD-STM32MP1 board with ph800480t013 rgb display 
#@NEEDED_BSPLAYERS: layers/meta-openembedded/meta-oe layers/meta-openembedded/meta-python layers/meta-st/meta-st-stm32mp-addons

include conf/machine/include/mp157a-common.inc

DEVICE_STORAGE = "EMMC:mmc0, NAND:nand0, NOR:nor0, SDCARD:mmc1, SPINAND:spi-nand0"

# Connected display orientation: 'portrait', 'landscape'
DISPLAY_ORIENTATION = "landscape"

# Define the boot device supported
BOOTDEVICE_LABELS += "emmc"

# Assign CubeMX Board devicetree and project path name
CUBEMX_DTB = "stm32mp157a-rgb-ph800480t013-emmc-mx"
CUBEMX_PROJECT = "mx/stm32mp157a-rgb-ph800480t013-emmc-mx"
```

## conf/machine/mp157a-rgb-ph-sd-mx.conf
```bitbake
#@TYPE: Machine
#@NAME: mp157a-rgb-ph-sd-mx
#@DESCRIPTION: Configuration for VisionSOM-STM32MP157A SD-card module with VisionCB-STD-STM32MP1 board with ph800480t013 rgb display 
#@NEEDED_BSPLAYERS: layers/meta-openembedded/meta-oe layers/meta-openembedded/meta-python layers/meta-st/meta-st-stm32mp-addons

include conf/machine/include/mp157a-common.inc

DEVICE_STORAGE = "SDCARD:mmc0, NAND:nand0, NOR:nor0, EMMC:mmc1, SPINAND:spi-nand0"

# Connected display orientation: 'portrait', 'landscape'
DISPLAY_ORIENTATION = "landscape"

# Define the boot device supported
BOOTDEVICE_LABELS += "sdcard"

# Assign CubeMX Board devicetree and project path name
CUBEMX_DTB = "stm32mp157a-rgb-ph800480t013-sd-mx"
CUBEMX_PROJECT = "mx/stm32mp157a-rgb-ph800480t013-sd-mx"
```

## conf/machine/stm32mp157a-visionsom-dsi-emmc-mx.conf
```bitbake
#@TYPE: Machine
#@NAME: stm32mp157a-visionsom-dsi-emmc-mx
#@DESCRIPTION: Configuration for STM32CubeMX generated project
#@NEEDED_BSPLAYERS: layers/meta-openembedded/meta-oe layers/meta-openembedded/meta-python layers/meta-st/meta-st-stm32mp-addons

include conf/machine/include/st-machine-common-stm32mp.inc
include conf/machine/include/st-machine-providers-stm32mp.inc

# Define specific familly common machine name
MACHINEOVERRIDES .= ":stm32mpvisionsommx"

# =========================================================================
# Chip architecture
# =========================================================================
DEFAULTTUNE = "cortexa7thf-neon-vfpv4"
include conf/machine/include/tune-cortexa7.inc

# =========================================================================
# Machine settings
# =========================================================================
STM32MP_DEVICETREE = "${CUBEMX_DTB}"

# =========================================================================
# Machine features (default for stm32mp1 like)
# =========================================================================
MACHINE_FEATURES += "splashscreen"
MACHINE_FEATURES += "watchdog"
MACHINE_FEATURES += "${@'gpu' if d.getVar('ACCEPT_EULA_'+d.getVar('MACHINE')) == '1' else ''}"
MACHINE_FEATURES += "m4copro"

# =========================================================================
# Device Storage
# =========================================================================
# Enable the board device storage support with CUBEMX_DTB according to BOOTDEVICE_LABELS
DEVICE_BOARD_ENABLE_EMMC  += "${@bb.utils.contains('BOOTDEVICE_LABELS', 'emmc', '${CUBEMX_DTB}', '', d)}"

DEVICE_STORAGE = "EMMC:mmc0"
DEVICE_STORAGE_TYPES = "mmc0"
EXTRA_IMAGEDEPENDS_remove = "sdcard-raw-tools-native"
ST_TOOLS_FOR_SDK_remove = "nativesdk-sdcard-raw-tools"

# =========================================================================
# Flashlayout
# =========================================================================
# Set the FLASHLAYOUT_TYPE_LABELS to CUBEMX_DTB according to BOOTDEVICE_LABELS
FLASHLAYOUT_TYPE_LABELS_emmc = "${@bb.utils.contains('BOOTDEVICE_LABELS', 'emmc', '${CUBEMX_DTB}', '', d)}"

# Specific settings for 'extensible' and 'deleteall' configurations
FLASHLAYOUT_CONFIG_LABELS_deleteall = "cubemx"
FLASHLAYOUT_TYPE_LABELS_deleteall_cubemx = "${CUBEMX_DTB}"
FLASHLAYOUT_TYPE_LABELS_extensible = "${CUBEMX_DTB}"

# =========================================================================
# CubeMX extra config
# =========================================================================
# Set specific subdir path by components for each device tree file location
# within CUBEMX_PROJECT project folder
CUBEMX_DTB_PATH_TFA     = "tf-a"
CUBEMX_DTB_PATH_TFA_SB  = "tf-a"
CUBEMX_DTB_PATH_UBOOT   = "u-boot"
CUBEMX_DTB_PATH_LINUX   = "kernel"
CUBEMX_DTB_PATH_OPTEEOS = "optee-os"


###########################################################################
#
# User machine customization sections
#
###########################################################################

# Boot Scheme
# =========================================================================
BOOTSCHEME_LABELS += "trusted"
UBOOT_CONFIG += "basic"
UBOOT_CONFIG[trusted] = "stm32mp15_visionsom_trusted_defconfig,,u-boot.stm32"

# Boot Device Choice
# =========================================================================
# Define the boot device supported
BOOTDEVICE_LABELS = "emmc"

# Support Feature Choice
# =========================================================================
# Define the features to enable on board
MACHINE_FEATURES += "bluetooth"
MACHINE_FEATURES += "wifi"
MACHINE_FEATURES += " dsi "

# Specific firmwares and kernel modules configuration
# =========================================================================
# Set the list of kernel module to be auto-loaded during boot
KERNEL_MODULE_AUTOLOAD += ""

# Set Bluetooth related package list needed when 'bluetooth' feature is enabled
BLUETOOTH_LIST += "linux-firmware-bluetooth-bcm4343"

# Set Wifi related package list needed when 'wifi' feature is enabled
WIFI_LIST += "linux-firmware-bcm43430"

# CubeMX Project Config
# =========================================================================
# Assign CubeMX Board devicetree and project path name
CUBEMX_DTB = "stm32mp157a-visionsom-dsi-emmc-mx"
CUBEMX_PROJECT = "mx/visionsom-dsi-emmc-mx"
```

## conf/machine/stm32mp157a-visionsom-dsi-mx.conf
```bitbake
#@TYPE: Machine
#@NAME: stm32mp157a-visionsom-dsi-mx
#@DESCRIPTION: Configuration for STM32CubeMX generated project
#@NEEDED_BSPLAYERS: layers/meta-openembedded/meta-oe layers/meta-openembedded/meta-python layers/meta-st/meta-st-stm32mp-addons

include conf/machine/include/st-machine-common-stm32mp.inc
include conf/machine/include/stm32mp1-mx-config.inc
include conf/machine/include/stm32mp1-mx-extlinux-config.inc
include conf/machine/include/stm32mp1-mx-common.inc

EXTLINUX_ROOT_SDCARD_stm32mp157a-visionsom-dsi-mx = "${@bb.utils.contains('ST_VENDORFS','1','root=/dev/mmcblk1p6','root=/dev/mmcblk1p5',d)}"

MACHINEOVERRIDES .= ":stm32mpvisionsommx"

# =========================================================================
# CubeMX extra config
# =========================================================================
# Set specific path by components for DT file location
CUBEMX_DTB_PATH_pn-tf-a-stm32mp     = "${STM32MP_SOMLABS_BASE}/mx/${CUBEMX_PROJECT}/tf-a"
CUBEMX_DTB_PATH_pn-u-boot-stm32mp   = "${STM32MP_SOMLABS_BASE}/mx/${CUBEMX_PROJECT}/u-boot"
CUBEMX_DTB_PATH_pn-linux-stm32mp    = "${STM32MP_SOMLABS_BASE}/mx/${CUBEMX_PROJECT}/kernel"
#CUBEMX_DTB_PATH_pn-optee-os-stm32mp = "${STM32MP_SOMLABS_BASE}/mx/${CUBEMX_PROJECT}/optee-os"

# =========================================================================
# User customizing sections
# =========================================================================

# Boot Scheme
# =========================================================================
# DISCO / EVAL : basic, trusted or optee
# =========================================================================
BOOTSCHEME_LABELS += "basic"
BOOTSCHEME_LABELS += "trusted"
#BOOTSCHEME_LABELS += "optee"

# Boot Device Choice
# =========================================================================
# DISCO : sdcard
# EVAL  : sdcard, emmc, nand-4-256, nor-sdcard, nor-emmc or nor-nand-4-256
# =========================================================================
# Define the config labels to use to generate flashlayout file
FLASHLAYOUT_CONFIG_LABELS += "sdcard"

# WARNING: configs below are only available with EVAL board
#FLASHLAYOUT_CONFIG_LABELS += "emmc"
#FLASHLAYOUT_CONFIG_LABELS += "nand-4-256"
#FLASHLAYOUT_CONFIG_LABELS += "nor-sdcard"
#FLASHLAYOUT_CONFIG_LABELS += "nor-emmc"
#FLASHLAYOUT_CONFIG_LABELS += "nor-nand-4-256"

# Board Type Choice
# =========================================================================
# DISCO : stm32mp157a-dk1 or stm32mp157c-dk2
# EVAL  : stm32mp157c-ev1
# =========================================================================
# Define the board reference devicetree name
# WARNING: only one setting allowed
#CUBEMX_DT_FILE_BASE = "stm32mp157a-dk1"
#CUBEMX_DT_FILE_BASE = "stm32mp157c-dk2"
#CUBEMX_DT_FILE_BASE = "stm32mp157c-ev1"

# CubeMX Project Config
# =========================================================================
# Assign CubeMX Board devicetree and project path name
CUBEMX_DTB = "stm32mp157a-visionsom-dsi-mx"
CUBEMX_PROJECT = "visionsom-dsi-mx"
 
MACHINE_FEATURES += " wifi "
MACHINE_FEATURES += " bluetooth "
MACHINE_FEATURES += " dsi "
UBOOT_CONFIG[basic]  = "stm32mp15_visionsom_basic_defconfig,,u-boot.img"
UBOOT_CONFIG[trusted]  = "stm32mp15_visionsom_trusted_defconfig,,u-boot.stm32"
```
